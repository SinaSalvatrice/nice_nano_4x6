## config/boards/shields/nice_nano_4x6/Kconfig.defconfig
```kconfig
if SHIELD_NICE_NANO_4X6

config ZMK_KEYBOARD_NAME
    default "nice_nano_4x6"

endif
```

## config/boards/shields/nice_nano_4x6/Kconfig.shield
```kconfig
# Configuration for nice_nano_4x6 Shield

# This file is used for the nice_nano_4x6 shield configuration in ZMK.

menuconfig NICE_NANO_4X6
    bool "nice_nano_4x6"
    default y
    help
        Configuration for the nice_nano_4x6 shield.
```
